## board/freescale/mx6ul_gateway/Kconfig
```kconfig
if TARGET_MX6UL_GATEWAY

config SYS_BOARD
	default "mx6ul_gateway"

config SYS_VENDOR
	default "freescale"

config SYS_CONFIG_NAME
	default "mx6ul_gateway"

config MX6UL_GATEWAY_EMMC_REWORK
	bool "Select this for the board with eMMC rework"

endif
```
